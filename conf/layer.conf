## conf/layer.conf
```bitbake
# We have a conf and classes directory, append to BBPATH
BBPATH =. "${LAYERDIR}:"

# We have a recipes directory, add to BBFILES
BBFILES += "${LAYERDIR}/recipes-*/*/*.bb ${LAYERDIR}/recipes-*/*/*.bbappend"

BBFILE_COLLECTIONS += "rust-bin-layer"
BBFILE_PATTERN_rust-bin-layer = "^${LAYERDIR}/"
BBFILE_PRIORITY_rust-bin-layer = "7"

LICENSE_PATH += "${LAYERDIR}/files/common-licenses"

LAYERSERIES_COMPAT_rust-bin-layer = " \
    dunfell \
    gatesgarth \
    hardknott \
    honister \
    kirkstone \
    langdale \
    mickledore \
    nanbield \
    scarthgap \
"
```
